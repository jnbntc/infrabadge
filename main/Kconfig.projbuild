## main/Kconfig.projbuild
```kconfig
menu "InfraBadge firmware"
choice IB_M0_PROFILE
    prompt "Hardware bring-up profile"
    default IB_M0_DISPLAY
config IB_M0_DISPLAY
    bool "1: Display InfraBadge M0 once"
config IB_M0_SENSORS
    bool "2: Battery, read-only RTC and SHTC3"
config IB_M0_SLEEP
    bool "3: One deep-sleep/wake cycle"
config IB_M1_UI
    bool "M1: offline display and button navigation"
config IB_M11_TIMER_DIAG
    bool "M1.1: manual start, three autonomous timer-only cycles"
config IB_M2_CONNECTIVITY
    bool "M2: provisioned STA/verified HTTPS, conditional render and sleep"
endchoice
config IB_M2_AUTO_DIAG
    bool "Separate autonomous M2 validation application (never production defaults)"
    depends on IB_M2_CONNECTIVITY
    default n
config IB_M35_UI
    bool "M3.5 bounded multisite UI, separate application"
    depends on IB_M2_CONNECTIVITY && !IB_M2_AUTO_DIAG
    default n
config IB_M36_ROAMING
    bool "M3.6 bounded roaming and night policy, separate profile"
    depends on IB_M35_UI
    default n
config IB_M0_SLEEP_SECONDS
    int "Deep sleep duration (seconds)"
    range 1 3600
    default 10
config IB_M0_WAKE_BUTTONS
    bool "Allow BOOT/PWR wake in addition to timer"
    default y
config IB_M1_SLEEP_SECONDS
    int "M1 timer wake duration (seconds)"
    range 1 3600
    default 60
endmenu
```

## sdkconfig.defaults
```kconfig
CONFIG_IDF_TARGET="esp32s3"
CONFIG_ESPTOOLPY_FLASHMODE_DIO=y
CONFIG_ESPTOOLPY_FLASHFREQ_40M=y
CONFIG_ESPTOOLPY_FLASHSIZE_8MB=y
CONFIG_ESP_CONSOLE_USB_SERIAL_JTAG=y
# The 5000-byte display buffer needs no PSRAM.
# CONFIG_SPIRAM is not set
CONFIG_PARTITION_TABLE_SINGLE_APP=y
CONFIG_COMPILER_OPTIMIZATION_SIZE=y
# CONFIG_ESP_WIFI_ENABLED is not set
# CONFIG_BT_ENABLED is not set
# CONFIG_SECURE_BOOT is not set
# CONFIG_SECURE_FLASH_ENC_ENABLED is not set
```
